## conf/layer.conf
```bitbake
# We have a conf and classes directory, add to BBPATH
BBPATH .= ":${LAYERDIR}"

# We have recipes-* directories, add to BBFILES
BBFILES += "${LAYERDIR}/recipes-*/*/*.bb \
	${LAYERDIR}/recipes-*/*/*.bbappend"

BBFILE_COLLECTIONS += "fsl-imx6-qtwayland"
BBFILE_PATTERN_fsl-imx6-qtwayland = "^${LAYERDIR}/"
BBFILE_PRIORITY_fsl-imx6-qtwayland = "6"
```
